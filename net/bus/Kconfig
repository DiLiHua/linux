## net/bus/Kconfig
```kconfig
#
# Bus Domain Sockets
#

config BUS
	tristate "Bus domain sockets"
	---help---
	  If you say Y here, you will include support for Bus domain sockets.
	  These sockets are used to create communication buses for IPC.

	  To compile this driver as a module, choose M here: the module will be
	  called bus.

	  Say Y unless you know what you are doing.
```

## net/netfilter/nfdbus/Kconfig
```kconfig
#
# Netfilter D-Bus module configuration
#
config NETFILTER_DBUS
	tristate "Netfilter D-bus"
	depends on BUS
	---help---
	  If you say Y here, you will include support for a netfilter hook to
	  parse D-Bus messages sent using the AF_BUS socket address family.

	  To compile this as a module, choose M here: the module will be
	  called netfilter_dbus.
```
